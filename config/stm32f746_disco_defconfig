## config/stm32f746_disco_defconfig
```kconfig
BR2_arm=y
BR2_cortex_m7=y
BR2_PACKAGE_HOST_LINUX_HEADERS_CUSTOM_5_4=y
BR2_TARGET_GENERIC_HOSTNAME="STM32F746"
BR2_TARGET_GENERIC_ISSUE="Welcome to STM32F746"
BR2_TARGET_GENERIC_ROOT_PASSWD="root"
BR2_LINUX_KERNEL=y
BR2_LINUX_KERNEL_CUSTOM_VERSION=y
BR2_LINUX_KERNEL_CUSTOM_VERSION_VALUE="5.4.46"
BR2_LINUX_KERNEL_USE_CUSTOM_CONFIG=y
BR2_LINUX_KERNEL_CUSTOM_CONFIG_FILE="../../config/stm32f746_disco_linux.config"
BR2_LINUX_KERNEL_DTS_SUPPORT=y
BR2_LINUX_KERNEL_INTREE_DTS_NAME="stm32f746-disco"
BR2_PACKAGE_BUSYBOX_CONFIG="package/busybox/busybox-minimal.config"
BR2_TARGET_ROOTFS_INITRAMFS=y
# BR2_TARGET_ROOTFS_TAR is not set
BR2_TARGET_UBOOT=y
BR2_TARGET_UBOOT_BUILD_SYSTEM_KCONFIG=y
BR2_TARGET_UBOOT_CUSTOM_VERSION=y
BR2_TARGET_UBOOT_CUSTOM_VERSION_VALUE="2018.07"
BR2_TARGET_UBOOT_PATCH="../../patch/u-boot_env.patch"
BR2_TARGET_UBOOT_BOARD_DEFCONFIG="stm32f746-disco"
BR2_TARGET_UBOOT_SPL=y
BR2_PACKAGE_HOST_OPENOCD=y
```
